// T32 Mon Feb 22 10:14:29 2021

B::

TOOLBAR   ON
STATUSBAR ON
FramePOS 484.88,9.3571,,,Maximized
WinPAGE.RESet

WinPAGE.Create P000
WinCLEAR

WinPOS 120.0 0.0 75. 15. 5. 0. W001
Frame.view

WinPOS 120.0 37.0 75. 10. 0. 0. W003
Register.view /SpotLight

WinPOS 0.0 0.0 116. 44. 16. 1. W004
WinTABS 10. 10. 25.
List `BMP280_init`

WinPOS 1.125 5.0714 115. 39. 16. 1. W005
WinTABS 10. 10. 25.
List e:`RTC_clear_alarm`

WinPOS 0.0 0.0 116. 44. 16. 1. W000
WinTABS 10. 10. 25.
List.auto

WinPOS 0.0 0.0 116. 44. 16. 1. W006
WinTABS 10. 10. 25.
List e:`RTC_set_configuration`

WinPOS 120.0 21.0 75. 10. 0. 0. W002
Var.Watch

VAR.ADDWATCH MODE_MGR_tick_timer_msecs_s
VAR.ADDWATCH status
VAR.ADDWATCH BMP280_temp_s
VAR.ADDWATCH timeout
VAR.ADDWATCH retry
VAR.ADDWATCH BMP280_error_s
VAR.ADDWATCH RTC_time_s

WinPAGE.select P000

ENDDO
